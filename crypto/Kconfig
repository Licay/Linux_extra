## crypto/Kconfig
```kconfig
# SPDX-License-Identifier: GPL-2.0

if CRYPTO && LICAY_LIB_CRYPTO
menu "Crypto external compression algorithms"

config CRYPTO_DELTA
	tristate "Delta compression support"
	select CRYPTO_ALGAPI
	select CRYPTO_ACOMP2
	help
	  This option enabled delta compression support.

config CRYPTO_LZ4K
	tristate "LZ4K compression algorithm"
	select CRYPTO_ALGAPI
	select LZ4K_COMPRESS
	select LZ4K_DECOMPRESS
	help
	  This is the LZ4K algorithm.

config CRYPTO_LZ4KD
	tristate "LZ4KD compression algorithm"
	select CRYPTO_ALGAPI
	select LZ4KD_COMPRESS
	select LZ4KD_DECOMPRESS
	help
	  This is the LZ4KD algorithm.

source "crypto/lz4k_oplus/Kconfig"

endmenu
endif
```

## lib/Kconfig
```kconfig
# SPDX-License-Identifier: GPL-2.0

menu "Licay lib module"

config LICAY_LIB_CRYPTO
	tristate "Licay lib crypto module"
	default n
	help
	  This is the Licay lib crypto module which provides
	  compression algorithms for use in the kernel.

config LZ4K_COMPRESS
	tristate

config LZ4K_DECOMPRESS
	tristate

config LZ4KD_COMPRESS
	tristate

config LZ4KD_DECOMPRESS
 	tristate

endmenu
```
